## component/MHZ14/Kconfig.projbuild
```kconfig
menu "MHZ14A configuration"
    config MHZ14A_PWM_PIN
        int "PWM GPIO Number"
        default 15
        help    
            GPIO Number for PWM.
endmenu
```

## component/TFT_DISPLAY/Kconfig.projbuild
```kconfig
menu "TFT configuration" 
    config TFT_PIN_NUM_LED
        int "LED GPIO Number"
        default 14
        help
            GPIO number for TFT LED.
    config PIN_NUM_SCK
        int "SCK GPIO Number"
        default 18
        help    
            GPIO number for SPI SCK.
    
    config PIN_NUM_MOSI
        int "MOSI GPIO Number"
        default 19
        help
            GPIO number for SPI MOSI.

    config TFT_PIN_NUM_DC
        int "DC GPIO Number"
        default 12
        help      
            GPIO number for TFT DC.

    config TFT_PIN_NUM_RESET
        int "Reset GPIO Number"
        default 15
        help    
            GPIO number for TFT Reset.

    config TFT_PIN_NUM_CS
        int "TFT Pin CS Number"
        default 13
        help
            GPIO number for TFT CS.
    
endmenu
```

## main/Kconfig.projbuild
```kconfig
menu "Device in use" 

    config NAME_DEVICE
        string "Name Device"
        default "AirSENSE_SPARC_LAB"
        help
            Name device.
    

endmenu
```
